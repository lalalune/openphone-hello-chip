## sw/buildroot/Config.in
```kconfig
menu "OpenAgent e1 BSP"

config BR2_PACKAGE_OPENAGENT_E1_BSP
	bool "OpenAgent e1 BSP smoke hooks"
	help
	  Import metadata for the OpenAgent e1 software BSP. The hardware
	  register contract is owned by sw/platform/e1_platform_contract.json.

source "$BR2_EXTERNAL_OPENAGENT_E1_PATH/package/e1-mmio-smoke/Config.in"
source "$BR2_EXTERNAL_OPENAGENT_E1_PATH/package/e1-npu-ml-smoke/Config.in"

endmenu
```

## sw/buildroot/package/e1-npu-ml-smoke/Config.in
```kconfig
config BR2_PACKAGE_HELLO_NPU_ML_SMOKE
	bool "hello-npu-ml-smoke"
	depends on BR2_USE_MMU
	help
	  Target-side /dev/hello-npu GEMM_S8 smoke. This is a deterministic
	  Linux driver/runtime check and rejects CPU-only fallback.

	  It is not NNAPI, Android HAL, or hardware benchmark evidence.
```

## sw/buildroot/package/hello-npu-ml-smoke/Config.in
```kconfig
config BR2_PACKAGE_HELLO_NPU_ML_SMOKE
	bool "hello-npu-ml-smoke"
	depends on BR2_USE_MMU
	help
	  Target-side /dev/hello-npu smoke for the first Buildroot rootfs.
	  It submits a deterministic tiny GEMM-style NPU job through the Linux
	  ioctl ABI and prints a bounded pass marker for evidence capture.

	  This is not NNAPI, Android, benchmark, or accelerator performance
	  evidence.

	  https://github.com/openphone/openphone-ai-soc
```

## sw/linux/Documentation/devicetree/bindings/openphone/openagent,e1-npu.yaml
```yaml
# SPDX-License-Identifier: (GPL-2.0-only OR BSD-2-Clause)
%YAML 1.2
---
$id: http://devicetree.org/schemas/openagent/openagent,e1-npu.yaml#
$schema: http://devicetree.org/meta-schemas/core.yaml#

title: OpenAgent e1 NPU

maintainers:
  - OpenAgent e1 BSP <bsp@openagent.invalid>

description: |
  4 KiB MMIO NPU block defined by sw/platform/e1_platform_contract.json
  (E1_NPU_BASE). The kernel driver creates /dev/e1-npu with read/ioctl/
  mmap and registers OP_A/OP_B/OPCODE/RESULT/PERF counters per the contract.

properties:
  compatible:
    const: openagent,e1-npu

  reg:
    maxItems: 1
    description: 4 KiB MMIO window at E1_NPU_BASE.

  interrupts:
    maxItems: 1
    description: IRQ_NPU completion line (optional - polled fallback supported).

  interrupt-names:
    items:
      - const: IRQ_NPU

required:
  - compatible
  - reg

additionalProperties: false

examples:
  - |
    npu@10020000 {
        compatible = "openagent,e1-npu";
        reg = <0x10020000 0x1000>;
        interrupt-names = "IRQ_NPU";
    };
```

## sw/linux/Documentation/devicetree/bindings/openphone/openphone,hello-display.yaml
```yaml
# SPDX-License-Identifier: (GPL-2.0-only OR BSD-2-Clause)
%YAML 1.2
---
$id: http://devicetree.org/schemas/openagent/openagent,e1-display.yaml#
$schema: http://devicetree.org/meta-schemas/core.yaml#

title: OpenAgent e1 display (simple-framebuffer compatible)

maintainers:
  - OpenAgent e1 BSP <bsp@openagent.invalid>

description: |
  4 KiB MMIO display scan-out block at E1_DISPLAY_BASE per
  sw/platform/e1_platform_contract.json. The driver programs FB_BASE /
  MODE / FORMAT / ENABLE from DT and expects a sibling "simple-framebuffer"
  node for /dev/fb0.

properties:
  compatible:
    const: openagent,e1-display

  reg:
    maxItems: 1

  interrupts:
    maxItems: 1

  interrupt-names:
    items:
      - const: IRQ_VSYNC

  openagent,mode:
    $ref: /schemas/types.yaml#/definitions/uint32
    description: Packed MODE register value (height<<16 | width).

  openagent,format:
    $ref: /schemas/types.yaml#/definitions/uint32
    description: Pixel format four-cc as a u32 (default "XR24" = 0x34325258).

  openagent,fb-base:
    $ref: /schemas/types.yaml#/definitions/uint32
    description: Physical base address of the framebuffer in DRAM.

required:
  - compatible
  - reg

additionalProperties: false

examples:
  - |
    display@10030000 {
        compatible = "openagent,e1-display";
        reg = <0x10030000 0x1000>;
        interrupt-names = "IRQ_VSYNC";
        openagent,mode = <0x01E00280>;
        openagent,format = <0x34325258>;
        openagent,fb-base = <0x80000000>;
    };
```

## sw/linux/Documentation/devicetree/bindings/openphone/openphone,hello-dma.yaml
```yaml
# SPDX-License-Identifier: (GPL-2.0-only OR BSD-2-Clause)
%YAML 1.2
---
$id: http://devicetree.org/schemas/openphone/openphone,hello-dma.yaml#
$schema: http://devicetree.org/meta-schemas/core.yaml#

title: OpenPhone hello DMA

maintainers:
  - OpenPhone hello BSP <bsp@openphone.invalid>

description: |
  4 KiB MMIO DMA contract block at HELLO_DMA_BASE per
  sw/platform/hello_platform_contract.json. The driver exports a sysfs
  contract string and live counters; it is not a dma-engine provider.

properties:
  compatible:
    const: openphone,hello-dma

  reg:
    maxItems: 1

  interrupts:
    maxItems: 1

  interrupt-names:
    items:
      - const: IRQ_DMA

required:
  - compatible
  - reg

additionalProperties: false

examples:
  - |
    dma@10010000 {
        compatible = "openphone,hello-dma";
        reg = <0x10010000 0x1000>;
        interrupt-names = "IRQ_DMA";
    };
```

## sw/linux/Documentation/devicetree/bindings/openphone/openphone,hello-gpio.yaml
```yaml
# SPDX-License-Identifier: (GPL-2.0-only OR BSD-2-Clause)
%YAML 1.2
---
$id: http://devicetree.org/schemas/openphone/openphone,hello-gpio.yaml#
$schema: http://devicetree.org/meta-schemas/core.yaml#

title: OpenPhone hello GPIO

maintainers:
  - OpenPhone hello BSP <bsp@openphone.invalid>

description: |
  32-bit GPIO_OUT register at HELLO_PERIPHERAL_CONTROL_BASE +
  HELLO_PERIPH_GPIO_OUT_OFFSET, wrapped as a 32-line gpiochip via gpio-mmio.

properties:
  compatible:
    const: openphone,hello-gpio

  reg:
    maxItems: 1
    description: 4 KiB peripheral-control window covering GPIO_OUT.

  gpio-controller: true

  "#gpio-cells":
    const: 2

required:
  - compatible
  - reg
  - gpio-controller
  - "#gpio-cells"

additionalProperties: false

examples:
  - |
    gpio@10000000 {
        compatible = "openphone,hello-gpio";
        reg = <0x10000000 0x1000>;
        gpio-controller;
        #gpio-cells = <2>;
    };
```

## sw/linux/Documentation/devicetree/bindings/openphone/openphone,hello-npu.yaml
```yaml
# SPDX-License-Identifier: (GPL-2.0-only OR BSD-2-Clause)
%YAML 1.2
---
$id: http://devicetree.org/schemas/openphone/openphone,hello-npu.yaml#
$schema: http://devicetree.org/meta-schemas/core.yaml#

title: OpenPhone hello NPU

maintainers:
  - OpenPhone hello BSP <bsp@openphone.invalid>

description: |
  4 KiB MMIO NPU block defined by sw/platform/hello_platform_contract.json
  (HELLO_NPU_BASE). The kernel driver creates /dev/hello-npu with read/ioctl/
  mmap and registers OP_A/OP_B/OPCODE/RESULT/PERF counters per the contract.

properties:
  compatible:
    const: openphone,hello-npu

  reg:
    maxItems: 1
    description: 4 KiB MMIO window at HELLO_NPU_BASE.

  interrupts:
    maxItems: 1
    description: IRQ_NPU completion line (optional - polled fallback supported).

  interrupt-names:
    items:
      - const: IRQ_NPU

required:
  - compatible
  - reg

additionalProperties: false

examples:
  - |
    npu@10020000 {
        compatible = "openphone,hello-npu";
        reg = <0x10020000 0x1000>;
        interrupt-names = "IRQ_NPU";
    };
```

## sw/linux/drivers/hello/Kconfig
```kconfig
menuconfig OPENAGENT_E1_BSP
	tristate "OpenAgent e1 BSP drivers"
	depends on OF
	help
	  Enables importable Linux drivers for the OpenAgent e1 platform
	  contract described by sw/platform/e1_platform_contract.json.

if OPENAGENT_E1_BSP

config OPENAGENT_E1_NPU
	tristate "OpenAgent e1 NPU contract driver"
	depends on MISC_DEVICES
	help
	  Exposes the openagent,e1-npu MMIO node through /dev/e1-npu for
	  smoke tests. The register base is E1_NPU_BASE in the platform
	  contract.

config OPENAGENT_E1_DMA
	tristate "OpenAgent e1 DMA contract driver"
	help
	  Binds the openagent,e1-dma MMIO node and exports a read-only sysfs
	  contract file for fast BSP validation.

config OPENAGENT_E1_CLINT_TIMER
	tristate "OpenAgent e1 CLINT timer driver"
	depends on GENERIC_CLOCKEVENTS
	help
	  Clocksource and clock_event_device backed by the e1 chip CLINT
	  mtime/mtimecmp registers (e1,clint-1.0).  Provides the Linux
	  scheduler tick and high-resolution timer for the single e1 hart.

config OPENAGENT_E1_PLIC
	tristate "OpenAgent e1 PLIC interrupt controller driver"
	depends on IRQ_DOMAIN
	help
	  IRQ domain driver for the e1_interrupt_controller.sv PLIC-style
	  block (e1,plic-1.0).  Exposes up to 8 interrupt sources (timer,
	  DMA, NPU, display) as Linux virtual IRQs via an irq_domain.

endif
```

## sw/linux/drivers/openphone/Kconfig
```kconfig
menuconfig OPENAGENT_E1
	tristate "OpenAgent e1 SoC BSP drivers"
	depends on OF
	help
	  Out-of-tree style BSP drivers for the OpenAgent e1 platform
	  contract (sw/platform/e1_platform_contract.json). Drop this
	  directory into an external Linux tree under drivers/misc/openagent/
	  and source this Kconfig from drivers/misc/Kconfig.

if OPENAGENT_E1

config OPENAGENT_E1_NPU
	tristate "OpenAgent e1 NPU character driver"
	depends on MISC_DEVICES
	help
	  Creates /dev/e1-npu and exposes the NPU register window through
	  read(), ioctl() (submit OP_A/OP_B/OPCODE), and mmap() of the 4 KiB
	  MMIO region. Bound to compatible "openagent,e1-npu".

config OPENAGENT_E1_DMA
	tristate "OpenAgent e1 DMA platform driver"
	help
	  Binds compatible "openagent,e1-dma" and exports a multi-line
	  platform-contract sysfs node plus live readback of BYTES_DONE and
	  ERROR_COUNT.

config OPENAGENT_E1_DISPLAY
	tristate "OpenAgent e1 display (simple-framebuffer compatible)"
	help
	  Programs FB_BASE / MODE / FORMAT / ENABLE from device tree and
	  leaves scan-out for userspace via a sibling simple-framebuffer
	  node. Bound to compatible "openagent,e1-display".

config OPENAGENT_E1_GPIO
	tristate "OpenAgent e1 GPIO (gpio-mmio backed)"
	depends on GPIOLIB
	select GPIO_GENERIC
	help
	  Wraps the GPIO_OUT register inside the peripheral-control window as
	  a 32-line gpio-mmio gpiochip. Bound to compatible
	  "openagent,e1-gpio".

endif # OPENAGENT_E1
```
